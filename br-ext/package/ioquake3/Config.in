## br-ext/package/ioquake3/Config.in
```kconfig
config BR2_PACKAGE_IOQUAKE3
	bool "ioquake3"
	depends on BR2_PACKAGE_SDL2_KMSDRM
	depends on BR2_PACKAGE_SDL2_OPENGLES
	help
	  ioquake3, the maintained Quake III Arena engine. Built for SDL2
	  on KMS/DRM with the OpenGL ES renderer path (r_preferOpenGLES),
	  so it runs on the console without X11 or Wayland. Game data
	  (baseq3/pak*.pk3) is not included.

	  https://github.com/ioquake/ioq3

comment "ioquake3 needs SDL2 with KMSDRM and OpenGL ES"
	depends on !BR2_PACKAGE_SDL2_KMSDRM || !BR2_PACKAGE_SDL2_OPENGLES
```

## br-ext/package/qrtr/Config.in
```kconfig
config BR2_PACKAGE_QRTR
	bool "qrtr"
	help
	  Qualcomm IPC Router (QRTR) library and tools: libqrtr,
	  qrtr-cfg and qrtr-lookup. The name service runs in the
	  kernel (CONFIG_QRTR), so qrtr-ns is not built.

	  https://github.com/linux-msm/qrtr
```

## br-ext/package/rmtfs/Config.in
```kconfig
config BR2_PACKAGE_RMTFS
	bool "rmtfs"
	depends on BR2_PACKAGE_HAS_UDEV
	select BR2_PACKAGE_QRTR
	help
	  Remote file system QMI service: serves the modem's EFS
	  partitions (modemst1/2, fsg, fsc) over the shared rmtfs
	  memory and can boot the modem remoteproc (-s).

	  https://github.com/linux-msm/rmtfs

comment "rmtfs needs udev /dev management"
	depends on !BR2_PACKAGE_HAS_UDEV
```

## br-ext/package/tqftpserv/Config.in
```kconfig
config BR2_PACKAGE_TQFTPSERV
	bool "tqftpserv"
	select BR2_PACKAGE_QRTR
	select BR2_PACKAGE_ZSTD
	help
	  TFTP server over QRTR: hands the modem the files it asks for
	  (the WLAN firmware wlanmdsp.mbn among them) from the directory
	  of its remoteproc firmware under /lib/firmware.

	  https://github.com/linux-msm/tqftpserv
```
